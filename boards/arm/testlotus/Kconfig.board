## boards/arm/testlotus/testlotus_defconfig
```kconfig
# testlotus_defconfig

CONFIG_SOC_SERIES_NRF52X=y
CONFIG_SOC_NRF52840_QIAA=y

# Enable UART and console.
CONFIG_SERIAL=y
CONFIG_CONSOLE=y

# Enable USB.
CONFIG_USB_DEVICE_STACK=y

# Build UF2 by default.
CONFIG_BUILD_OUTPUT_UF2=y
CONFIG_USE_DT_CODE_PARTITION=y
```
